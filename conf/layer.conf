## conf/layer.conf
```bitbake
# We have a conf and classes directory, add to BBPATH
BBPATH .= ":${LAYERDIR}"

# We have a recipes-* directories, add to BBFILES
BBFILES += "${LAYERDIR}/recipes-*/*/*.bb \
	${LAYERDIR}/recipes-*/*/*.bbappend"
BBFILES += "${LAYERDIR}/images/*.bb*"

BBFILE_COLLECTIONS += "linstax"
BBFILE_PATTERN_linstax = "^${LAYERDIR}/"
BBFILE_PRIORITY_linstax = "6"

# Additional license directories.
LICENSE_PATH += "${LAYERDIR}/files/additional-licenses"
```
